## app/boards/my_rpi_pico2/board.yml
```yaml
board:
  name: my_rpi_pico2
  full_name: My Custom Raspberry Pi Pico 2
  vendor: myraspberrypi
  socs:
  - name: rp2350a
```

## app/boards/pico2_scratch/Kconfig.pico2_scratch
```kconfig
config BOARD_PICO2_SCRATCH
	select SOC_RP2350A_M33 if BOARD_PICO2_SCRATCH_RP2350A_M33
```

## app/boards/pico2_scratch/board.yml
```yaml
board:
  name: pico2_scratch
  full_name: Raspberry Pi Pico 2 from scratch
  vendor: myraspberrypi
  socs:
  - name: rp2350a
```

## dts/bindings/my,pico2driver.yaml
```yaml
description: RPI pico 2 LED driver
comaptible: "my,pico2driver"
include: base.yaml
```
