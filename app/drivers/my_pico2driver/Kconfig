## app/drivers/my_pico2driver/Kconfig
```kconfig
config MY_PICO2DRIVER
    bool "My RPI pico2 driver"
    default y

if SHELL
config MY_PICO2DRIVER_SHELL
    bool "My RPI pico2driver shell commands"
endif #CONFIG_SHELL
```

## tests/ring_buf/testcase.yaml
```yaml
common:
  tags:
    - unit
    - ring_buf
    - ztest
    - homework

tests:
  homework.unit.ring_buf:
    platform_allow:
      - native_sim
      - native_sim/native/64
    timeout: 60
```
